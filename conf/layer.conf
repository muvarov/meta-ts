## conf/layer.conf
```bitbake
# We might have a conf and classes directory, append to BBPATH
BBPATH .= ":${LAYERDIR}"

# We have a recipes directory, add to BBFILES
BBFILES += "${LAYERDIR}/recipes*/*/*.bb ${LAYERDIR}/recipes*/*/*.bbappend"

BBFILE_COLLECTIONS += "meta-trusted-substrate"
BBFILE_PATTERN_meta-trusted-substrate := "^${LAYERDIR}/"
BBFILE_PRIORITY_meta-trusted-substrate = "9"

# This should only be incremented on significant changes that will
# cause compatibility issues with other layers
LAYERVERSION_meta-trusted-substrate = "1"
LAYERSERIES_COMPAT_meta-trusted-substrate = "hardknott gatesgarth"
```

## conf/machine/ledge-synquacer.conf
```bitbake
#@TYPE: Machine
#@NAME: generic armv8 machine
#@DESCRIPTION: Machine configuration for running a generic armv8

require conf/machine/include/tune-cortexa53.inc

OPTEEMACHINE = "synquacer"
OPTEEOUTPUTMACHINE = "synquacer"

SERIAL_CONSOLES ?= "115200;ttyAMA0"
SERIAL_CONSOLES_CHECK = "${SERIAL_CONSOLES}"

MACHINE_FEATURES += "optee"
MACHINE_FEATURES += "tpm2"
MACHINE_FEATURES += "ftpm"

PREFERRED_PROVIDER_virtual/bootloader = "u-boot-ledge"
UBOOT_CONFIG = "basic"
UBOOT_CONFIG[basic]   = "synquacer_developerbox_defconfig,,u-boot.bin"
EXTRA_IMAGEDEPENDS_append = " virtual/bootloader"

MACHINE_EXTRA_RDEPENDS += " \
    optee-os \
    trusted-firmware-a-ledge \
    scp-firmware \
    "
```

## meta-trustedsubstrate/conf/layer.conf
```bitbake
# We have a conf and classes directory, add to BBPATH
BBPATH .= ":${LAYERDIR}"

# We have recipes-* directories, add to BBFILES
BBFILES += "${LAYERDIR}/recipes-*/*/*.bb \
            ${LAYERDIR}/recipes-*/*/*.bbappend"

BBFILE_COLLECTIONS += "meta-trustedsubstrate"
BBFILE_PATTERN_meta-trustedsubstrate = "^${LAYERDIR}/"
BBFILE_PRIORITY_meta-trustedsubstrate = "9"

LAYERDEPENDS_meta-trustedsubstrate = " \
    meta-arm \
"
LAYERSERIES_COMPAT_meta-arm = "honister"
```

## meta-trustedsubstrate/conf/machine/ledge-synquacer.conf
```bitbake
#@TYPE: Machine
#@NAME: generic armv8 machine
#@DESCRIPTION: Machine configuration for running a generic armv8

require conf/machine/include/arm/armv8a/tune-cortexa57.inc

MACHINEOVERRIDES =. "ledge-synquacer:"

# TF-A
TFA_PLATFORM = "synquacer"
PREFERRED_VERSION_trusted-firmware-a ?= "2.5%"
EXTRA_IMAGEDEPENDS += "virtual/trusted-firmware-a"

# optee
EXTRA_IMAGEDEPENDS += "optee-os"
OPTEE_ARCH = "arm64"
OPTEE_BINARY = "tee-pager_v2.bin"
MACHINE_FEATURES += "optee-ftpm"

# u-boot
PREFERRED_VERSION_u-boot ?= "2021.10"
EXTRA_IMAGEDEPENDS += "u-boot"
UBOOT_CONFIG ??= "EFI"
UBOOT_CONFIG[EFI] = "synquacer_developerbox_defconfig"
UBOOT_ENTRYPOINT  = "0x80000000"
UBOOT_LOADADDRESS = "0x80000000"
UBOOT_BOOTARGS = "earlycon=pl011,0x1a510000 console=ttyAMA0 loglevel=9"
UBOOT_ARCH = "arm"
UBOOT_EXTLINUX = "0"

SERIAL_CONSOLES ?= "115200;ttyAMA0"
SERIAL_CONSOLES_CHECK = "${SERIAL_CONSOLES}"

PREFERRED_PROVIDER_virtual/kernel ?= "linux-yocto"
```

## meta-trustedsubstrate/conf/machine/rockpi4b.conf
```bitbake
#@TYPE: Machine
#@NAME: generic armv8 machine
#@DESCRIPTION: Machine configuration for running a generic armv8

SOC_FAMILY = "rk3399"

DEFAULTTUNE ?= "cortexa72-cortexa53-crypto"

require conf/machine/include/soc-family.inc
require conf/machine/include/arm/armv8a/tune-cortexa72-cortexa53.inc

MACHINEOVERRIDES =. "rockpi4b:"

# Kernel
KERNEL_DEVICETREE = "rockchip/rk3399-rock-pi-4b.dtb"

WKS_FILE_DEPENDS ?= " \
        mtools-native \
        dosfstools-native \
        virtual/bootloader \
        virtual/kernel \
        "
# TF-A
TFA_PLATFORM = "rk3399"
PREFERRED_VERSION_trusted-firmware-a ?= "2.5%"

# optee
EXTRA_IMAGEDEPENDS += "optee-os"
OPTEE_ARCH = "arm64"
OPTEE_BINARY = "tee-pager_v2.bin"
MACHINE_FEATURES += "optee-ftpm"

# u-boot
PREFERRED_VERSION_u-boot ?= "2021.10"
UBOOT_CONFIG ??= "EFI"
UBOOT_CONFIG[EFI] = "rockpi4b_defconfig"
UBOOT_ENTRYPOINT ?= "0x06000000"
UBOOT_ARCH = "arm"
UBOOT_EXTLINUX_CONSOLE = "console=ttyS2,1500000"
UBOOT_SUFFIX ?= "itb"
SPL_BINARY ?= "idbloader.img"

IMAGE_BOOT_FILES ?= "u-boot.itb  idbloader.img"

SERIAL_CONSOLES ?= "1500000;ttyS0"
SERIAL_CONSOLES_CHECK = "${SERIAL_CONSOLES}"

EXTRA_IMAGEDEPENDS += " u-boot"

IMAGE_FSTYPES += "wic.gz"
WKS_FILE ?= "rockpi4b.wks.in"
WKS_FILE_DEPENDS += "u-boot"
```

## meta-trustedsubstrate/conf/machine/rpi4.conf
```bitbake
#@TYPE: Machine
#@NAME: generic armv8 machine
#@DESCRIPTION: Machine configuration for running a generic armv8

include conf/machine/include/arm/arch-armv8.inc
include conf/machine/include/arm/arch-armv8a.inc

# u-boot
PREFERRED_VERSION_u-boot ?= "2021.10"
EXTRA_IMAGEDEPENDS += "u-boot"
UBOOT_CONFIG ??= "EFI"
UBOOT_CONFIG[EFI] = "rpi4_defconfig"
#UBOOT_BOOTARGS = "earlycon=uart8250,mmio32,0xfe215040 console=serial0 loglevel=9"
UBOOT_ARCH = "arm"
UBOOT_EXTLINUX = "0"

SERIAL_CONSOLES ?= "115200;serial0"
SERIAL_CONSOLES_CHECK = "${SERIAL_CONSOLES}"

#WIC
IMAGE_FSTYPES += "wic"
WKS_FILE ?= "rpi4.wks.in"
IMAGE_BOOT_FILES ?= "u-boot.bin bcm2711-rpi-4-b.dtb fixup4.dat config.txt start4.elf overlays/*;overlays/"
WKS_FILE_DEPENDS += "u-boot"
```

## meta-trustedsubstrate/conf/machine/stm32mp157c-dk2.conf
```bitbake
#@TYPE: Machine
#@NAME: generic armv7 machine
#@DESCRIPTION: Machine configuration for running a generic armv8

require conf/machine/include/arm/armv7a/tune-cortexa7.inc

MACHINEOVERRIDES =. "stm32mp157c-dk2:"

IMAGE_FSTYPES:remove = "tar.gz"

# TF-A
TFA_PLATFORM = "stm32mp157c-dk2:"
PREFERRED_VERSION_trusted-firmware-a ?= "2.5%"
EXTRA_IMAGEDEPENDS += "trusted-firmware-a"

# optee
EXTRA_IMAGEDEPENDS += "optee-os"
OPTEE_ARCH = "arm32"
OPTEE_BINARY = "tee-pager_v2.bin"

# u-boot
PREFERRED_VERSION_u-boot ?= "2021.10"
EXTRA_IMAGEDEPENDS += "u-boot"
UBOOT_CONFIG ??= "EFI"
UBOOT_CONFIG[EFI] = "stm32mp157c_dk2_trusted_defconfig"
#UBOOT_ENTRYPOINT  = "0x80000000"
#UBOOT_LOADADDRESS = "0x80000000"
#UBOOT_BOOTARGS = "earlycon=pl011,0x1a510000 console=ttyAMA0 loglevel=9"
UBOOT_ARCH = "arm"
UBOOT_EXTLINUX = "0"

SERIAL_CONSOLES ?= "115200;ttyAMA0"
SERIAL_CONSOLES_CHECK = "${SERIAL_CONSOLES}"

PREFERRED_PROVIDER_virtual/kernel ?= "linux-yocto"
```

## meta-trustedsubstrate/conf/machine/stm32mp157c-ev1.conf
```bitbake
#@TYPE: Machine
#@NAME: generic armv7 machine
#@DESCRIPTION: Machine configuration for running a generic armv8

require conf/machine/include/arm/armv7a/tune-cortexa7.inc

MACHINEOVERRIDES =. "stm32mp157c-ev1:"

IMAGE_FSTYPES:remove = "tar.gz"

# TF-A
TFA_PLATFORM = "stm32mp157c-ev1:"
PREFERRED_VERSION_trusted-firmware-a ?= "2.6%"
EXTRA_IMAGEDEPENDS += "trusted-firmware-a"

# optee
EXTRA_IMAGEDEPENDS += "optee-os"
OPTEE_ARCH = "arm32"
OPTEE_BINARY = "tee-pager_v2.bin"

# u-boot
PREFERRED_VERSION_u-boot ?= "2021.10"
EXTRA_IMAGEDEPENDS += "u-boot"
UBOOT_CONFIG ??= "EFI"
UBOOT_CONFIG[EFI] = "stm32mp157c_ev1_trusted_defconfig"
#UBOOT_ENTRYPOINT  = "0x80000000"
#UBOOT_LOADADDRESS = "0x80000000"
#UBOOT_BOOTARGS = "earlycon=pl011,0x1a510000 console=ttyAMA0 loglevel=9"
UBOOT_ARCH = "arm"
UBOOT_EXTLINUX = "0"

SERIAL_CONSOLES ?= "115200;ttyAMA0"
SERIAL_CONSOLES_CHECK = "${SERIAL_CONSOLES}"

#WIC
IMAGE_FSTYPES += "wic"
WKS_FILE ?= "stm32mp157c-ev1.wks.in"
WKS_FILE_DEPENDS += "trusted-firmware-a"
```

## meta-trustedsubstrate/conf/machine/ts-extlinux.conf
```bitbake
UBOOT_EXTLINUX = "1"
UBOOT_EXTLINUX_MENU_DESCRIPTION = "UEFI secure kernel boot"
UBOOT_EXTLINUX_CONSOLE = "console=ttyS0,115200"
UBOOT_EXTLINUX_LABELS  = "default"
UBOOT_EXTLINUX_KERNEL_ARGS = "rootwait panic=60"
UBOOT_EXTLINUX_KERNEL_IMAGE = "/efi/boot/bootaa64.efi"
UBOOT_EXTLINUX_FDTDIR = "/dtbs/"
UBOOT_EXTLINUX_INITRD = "/ledge-initramfs.rootfs.cpio.gz"
UBOOT_EXTLINUX_ROOT = "root=UUID=6091b3a4-ce08-3020-93a6-f755a22ef03b"
```

## meta-trustedsubstrate/conf/machine/zynqmp-starter.conf
```bitbake
#@TYPE: Machine
#@NAME: generic armv8 machine
#@DESCRIPTION: Machine configuration for running a generic armv8

include conf/machine/include/arm/arch-armv8.inc
include conf/machine/include/arm/arch-armv8a.inc

# TF-A
TFA_PLATFORM = "zynqmp"
PREFERRED_VERSION_trusted-firmware-a ?= "2.6%"
EXTRA_IMAGEDEPENDS += "trusted-firmware-a"

# u-boot
PREFERRED_VERSION_u-boot ?= "2022.01"
EXTRA_IMAGEDEPENDS += "u-boot"
UBOOT_CONFIG ??= "EFI"
UBOOT_CONFIG[EFI] = "xilinx_zynqmp_starter_defconfig"
UBOOT_ARCH = "arm"
UBOOT_EXTLINUX = "0"

SERIAL_CONSOLES ?= "115200;ttyPS1"
SERIAL_CONSOLES_CHECK = "${SERIAL_CONSOLES}"
```
