/dts-v1/;

/ {
	compatible = "brcm,bcm2835\0brcm,bcm2708\0brcm,bcm2709";

	fragment@0 {
		target = <0xffffffff>;

		__overlay__ {
			compatible = "spi-gpio";
			pinctrl-names = "default";
			pinctrl-0 = <0xffffffff>;
			gpio-sck = <0xffffffff 0x0b 0x00>;
			gpio-mosi = <0xffffffff 0x0a 0x00>;
			gpio-miso = <0xffffffff 0x09 0x00>;
			cs-gpios = <0xffffffff 0x07 0x01>;
			spi-delay-us = <0x00>;
			#address-cells = <0x01>;
			#size-cells = <0x00>;
			status = "okay";
			sck-gpios = <0xffffffff 0x0b 0x00>;
			mosi-gpios = <0xffffffff 0x0a 0x00>;
			miso-gpios = <0xffffffff 0x09 0x00>;
			num-chipselects = <0x01>;

			slb9670@0 {
				compatible = "infineon,slb9670\0tis,tpm2-spi\0tcg,tpm_tis-spi";
				reg = <0x00>;
				gpio-reset = <0xffffffff 0x18 0x01>;
				#address-cells = <0x01>;
				#size-cells = <0x00>;
				status = "okay";
				spi-max-frequency = <0xf4240>;
				phandle = <0x01>;
			};
		};
	};

	fragment@1 {
		target = <0xffffffff>;

		__overlay__ {
			brcm,pins = <0x07 0x08 0x09 0x0a 0x0b 0x18>;
			brcm,function = <0x00>;
		};
	};

	fragment@2 {
		target = <0xffffffff>;

		__overlay__ {
			status = "disabled";
		};
	};

	fragment@3 {
		target = <0xffffffff>;

		__overlay__ {
			status = "disabled";
		};
	};

	__symbols__ {
		slb9670 = "/fragment@0/__overlay__/slb9670@0";
	};

	__fixups__ {
		spi0 = "/fragment@0:target:0";
		spi0_gpio7 = "/fragment@0/__overlay__:pinctrl-0:0\0/fragment@1:target:0";
		gpio = "/fragment@0/__overlay__:gpio-sck:0\0/fragment@0/__overlay__:gpio-mosi:0\0/fragment@0/__overlay__:gpio-miso:0\0/fragment@0/__overlay__:cs-gpios:0\0/fragment@0/__overlay__:sck-gpios:0\0/fragment@0/__overlay__:mosi-gpios:0\0/fragment@0/__overlay__:miso-gpios:0\0/fragment@0/__overlay__/slb9670@0:gpio-reset:0";
		spidev0 = "/fragment@2:target:0";
		spidev1 = "/fragment@3:target:0";
	};
};
